/**
 * @cliArgs --device "F28004x" --part "F28004x_100PZ" --package "F28004x_100PZ" --context "system" --product "C2000WARE@5.04.00.00"
 * @versions {"tool":"1.22.0+3893"}
 */

/**
 * Import the modules used in this configuration.
 */
const adc     = scripting.addModule("/driverlib/adc.js", {}, false);
const adc1    = adc.addInstance();
const adc2    = adc.addInstance();
const adc3    = adc.addInstance();
const asysctl = scripting.addModule("/driverlib/asysctl.js");
const spi     = scripting.addModule("/driverlib/spi.js", {}, false);
const spi1    = spi.addInstance();

/**
 * Write custom configuration values to the imported modules.
 */
adc1.adcClockPrescaler        = "ADC_CLK_DIV_2_0";
adc1.interruptPulseMode       = "ADC_PULSE_END_OF_CONV";
adc1.soc0Trigger              = "ADC_TRIGGER_EPWM1_SOCA";
adc1.soc1Trigger              = "ADC_TRIGGER_EPWM1_SOCA";
adc1.soc2Trigger              = "ADC_TRIGGER_EPWM1_SOCA";
adc1.enabledInts              = ["ADC_INT_NUMBER1"];
adc1.enableInterrupt1         = true;
adc1.registerInterrupts       = ["1"];
adc1.adcBase                  = "ADCB_BASE";
adc1.soc0Channel              = "ADC_CH_ADCIN1";
adc1.soc1Channel              = "ADC_CH_ADCIN2";
adc1.enabledSOCs              = ["ADC_SOC_NUMBER0","ADC_SOC_NUMBER1","ADC_SOC_NUMBER2"];
adc1.socHighPriorityMode      = "ADC_PRI_THRU_SOC1_HIPRI";
adc1.$name                    = "B_Channel";
adc1.soc0SampleWindow         = 10;
adc1.soc1SampleWindow         = 15;
adc1.soc2SampleWindow         = 15;
adc1.adcInt1.enableInterrupt  = true;
adc1.adcInt1.interruptHandler = "INT_myADC0_1_ISR";
adc1.adcInt1.$name            = "ADC_ISR";

adc2.adcBase             = "ADCC_BASE";
adc2.adcClockPrescaler   = "ADC_CLK_DIV_2_0";
adc2.interruptPulseMode  = "ADC_PULSE_END_OF_CONV";
adc2.soc0Trigger         = "ADC_TRIGGER_EPWM1_SOCA";
adc2.soc1Trigger         = "ADC_TRIGGER_EPWM1_SOCA";
adc2.soc2Trigger         = "ADC_TRIGGER_EPWM1_SOCA";
adc2.soc0Channel         = "ADC_CH_ADCIN2";
adc2.soc2Channel         = "ADC_CH_ADCIN4";
adc2.soc2SampleWindow    = 8;
adc2.socHighPriorityMode = "ADC_PRI_SOC0_HIPRI";
adc2.$name               = "C_Channel";
adc2.enabledSOCs         = ["ADC_SOC_NUMBER0","ADC_SOC_NUMBER1"];
adc2.soc1Channel         = "ADC_CH_ADCIN5";
adc2.soc0SampleWindow    = 15;
adc2.soc1SampleWindow    = 15;

adc3.adcClockPrescaler = "ADC_CLK_DIV_2_0";
adc3.$name             = "A_Channel";
adc3.enabledSOCs       = ["ADC_SOC_NUMBER0"];
adc3.soc0Channel       = "ADC_CH_ADCIN6";
adc3.soc0Trigger       = "ADC_TRIGGER_EPWM1_SOCA";
adc3.soc0SampleWindow  = 15;

asysctl.analogReference        = "INTERNAL";
asysctl.analogReferenceVoltage = "1P65";

spi1.$name          = "mySPI0";
spi1.mode           = "SPI_MODE_CONTROLLER";
spi1.picoQual.$name = "myGPIOQUAL0";
spi1.pociQual.$name = "myGPIOQUAL1";
spi1.clkQual.$name  = "myGPIOQUAL2";
spi1.pteQual.$name  = "myGPIOQUAL3";

/**
 * Pinmux solution for unlocked pins/peripherals. This ensures that minor changes to the automatic solver in a future
 * version of the tool will not impact the pinmux you originally saw.  These lines can be completely deleted in order to
 * re-solve from scratch.
 */
spi1.spi.$suggestSolution             = "SPIB";
spi1.spi.spi_picoPin.$suggestSolution = "GPIO24";
spi1.spi.spi_pociPin.$suggestSolution = "GPIO25";
spi1.spi.spi_clkPin.$suggestSolution  = "GPIO14";
spi1.spi.spi_ptePin.$suggestSolution  = "GPIO15";
